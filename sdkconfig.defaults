## sdkconfig.defaults
```kconfig
# sdkconfig.defaults
CONFIG_FREERTOS_HZ=1000
CONFIG_ESP_TASK_WDT_EN=y  # Detects stuck tasks
CONFIG_ESP_INT_WDT=y      # Detects stuck ISRs
```

## sdkconfig.defaults.debug
```kconfig
# sdkconfig.defaults.debug
CONFIG_FREERTOS_CHECK_STACKOVERFLOW_CANARY=y
CONFIG_HEAP_POISONING_COMPREHENSIVE=y
CONFIG_FREERTOS_USE_TRACE_FACILITY=y
CONFIG_FREERTOS_GENERATE_RUN_TIME_STATS=y
```
